## programa/cliente/main/Kconfig.projbuild
```kconfig
menu "Configuração do Wifi Configuration"

    config ESP_WIFI_SSID
        string "WiFi SSID"
        default "ssid"
        help
            Nome da rede Wifi.

    config ESP_WIFI_PASSWORD
        string "Senha do Wifi"
        default "minha_senha"
        help
            Senha do WiFi (WPA or WPA2).

    config ESP_MAXIMUM_RETRY
        int "Número máximo de tentativas de conexão"
        default 5
        help
            Configure o valor máximo de tentativas de conexão.
endmenu

menu "Configuração HTTP Configuration"

    config IP_TACK_KEY
        string "chave do iptack"
        default "minha_chave"
        help
            Chave do iptack.

    config OPEN_WEATHER_MAP_KEY
        string "chave do openweathermap"
        default "minha_chave"
        help
            Chave do openweathermap.

endmenu
```
